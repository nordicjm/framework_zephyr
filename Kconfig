## Kconfig
```kconfig
#
# Copyright (c) 2020-2021 Laird Connectivity
#
# It is provided "as is", without warranty/guarantee of any kind, express of
# implied, including but not limited to the warranties of merchantability,
# fitness for a particular purpose and non-infringement.
#

menuconfig FRAMEWORK
	bool "Laird Connectivity Message Framework"
	help
	  Inter-task communication using messages

if FRAMEWORK

choice
	prompt "Framework Assertion"
	optional
	help
	  The default is disabled.

config FWK_ASSERT_ENABLED
	bool "Enable Framework assertion"

config FWK_ASSERT_ENABLED_USE_ZEPHYR
	bool "Framework assertion maps to Zephyr assertion"
	help
	  The framework assertion is enabled if
	  Zephyr assertions are enabled.

endchoice

if FWK_ASSERT_ENABLED || FWK_ASSERT_ENABLED_USE_ZEPHYR

config FWK_DEBUG
	bool "Enable Framework Debug (and debug assertions)"

config FWK_ASSERT_ON_BROADCAST_FROM_ISR
	bool "Assert when a broadcast msg occurs in ISR context"
	default y
	help
	  Broadcast can be time consuming on some processors.

endif # FWK_ASSERT_ENABLED || FWK_ASSERT_ENABLED_USE_ZEPHYR

config FWK_RESET_DELAY_MS
	int "Delay before software reset (from an assertion or reset message)"
	default 5000

config FWK_MAX_MSG_RECEIVERS
	int "The maximum number of messages receivers"
	default 4

config BUFFER_POOL_SIZE
	int "Zephyr heap used by the framework"
	default 4096

config BUFFER_POOL_STATS
	bool "Enable buffer pool statistics"

config BUFFER_POOL_WINDOW_SIZE
	int "Number of entries in stats of recently used sizes"
	default 0
	help
	  Requires 2 bytes per entry

config BUFFER_POOL_CHECK_DOUBLE_FREE
	bool "Print error if duplicate free is detected"
	help
	  Requires 4 bytes per allocation.

config BUFFER_POOL_SHELL
	bool "Enable Buffer Pool Shell"

config FWK_AUTO_GENERATE_FILES
	bool "Generate ID/message file automatically"
	help
	  Automatically generates files for IDs and messages that can be
	  included in projects containing all of the framework IDs and messages
	  which can come from multiple sources/components. Individual projects
	  must configure the FWK_ID_FILE_LIST global property list and
	  FWK_MSG_FILE_LIST global property list from their CMake file (using
	  set_property() to append) which must contain lists of files which then
	  get included in the build. Applications can include framework_ids.h
	  and framework_msgcodes.h to access these values. Note that
	  cmake_functions contains helper functions for adding files using
	  add_fwk_id_file(file) and add_fwk_msgcode_file(file) - modules using
	  this must have cmake_functions added to their depends
	  zephyr/module.yml file and framework must be at the bottom of the west
	  manifest file.

if FWK_AUTO_GENERATE_FILES

config FWK_SENSOR
	bool "Include sensor framework message codes"
	help
	  Includes framework message codes that can be used by sensors.

endif # FWK_AUTO_GENERATE_FILES

endif # FRAMEWORK
```
